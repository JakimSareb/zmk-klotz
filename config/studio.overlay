/ {
    chosen {
        zmk,physical-layout = &studio_layout;
    };

    studio_layout: studio_layout {
        compatible = "zmk,physical-layout";
        display-name = "Default";
        transform = <&default_transform>;
        kscan = <&kscan0>;
    };
};
